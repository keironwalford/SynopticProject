## CMakeLists.txt
```
cmake_minimum_required(VERSION 3.20.0)

find_package(Zephyr REQUIRED HINTS $ENV{ZEPHYR_BASE})
project(chat2)

# NORDIC SDK APP START
target_sources(app PRIVATE
	src/main.c
	src/model_handler.c
	src/chat_cli.c)
target_include_directories(app PRIVATE include)
# NORDIC SDK APP END
```

## prj.conf
```kconfig
CONFIG_NCS_SAMPLES_DEFAULTS=y

CONFIG_LOG_MODE_DEFERRED=y

# General configuration
CONFIG_NCS_APPLICATION_BOOT_BANNER_STRING="Mesh Chat"
CONFIG_SYSTEM_WORKQUEUE_STACK_SIZE=2048
CONFIG_FLASH=y
CONFIG_FLASH_MAP=y
CONFIG_NVS=y
CONFIG_SETTINGS=y
CONFIG_NVS_LOOKUP_CACHE=y
CONFIG_SETTINGS_NVS_NAME_CACHE=y
CONFIG_HWINFO=y
CONFIG_DK_LIBRARY=y
CONFIG_PM_SINGLE_IMAGE=y
CONFIG_PM_PARTITION_SIZE_SETTINGS_STORAGE=0x8000
CONFIG_SOC_FLASH_NRF_PARTIAL_ERASE=y

# Bluetooth configuration
CONFIG_BT=y
CONFIG_BT_DEVICE_NAME="Mesh Chat"
CONFIG_BT_L2CAP_TX_BUF_COUNT=8
CONFIG_BT_OBSERVER=y
CONFIG_BT_PERIPHERAL=y
CONFIG_BT_SETTINGS=y

# Disable unused Bluetooth features
CONFIG_BT_CTLR_LE_ENC=n
CONFIG_BT_PHY_UPDATE=n
CONFIG_BT_CTLR_CHAN_SEL_2=n
CONFIG_BT_CTLR_MIN_USED_CHAN=n
CONFIG_BT_CTLR_PRIVACY=n

# Bluetooth Mesh configuration
CONFIG_BT_MESH=y
CONFIG_BT_MESH_RELAY=y
CONFIG_BT_MESH_FRIEND=y
CONFIG_BT_MESH_RX_SEG_MAX=10
CONFIG_BT_MESH_TX_SEG_MAX=10
CONFIG_BT_MESH_PB_GATT=y
CONFIG_BT_MESH_GATT_PROXY=y
CONFIG_BT_MESH_DK_PROV=y

# Enable Bluetooth Mesh models debug logs
CONFIG_BT_MESH_LOG_LEVEL_DBG=y

# Enable Shell module and use UART as a backend
CONFIG_SHELL=y
CONFIG_SHELL_BACKEND_SERIAL=y
CONFIG_FLASH_SHELL=n

CONFIG_LOG_BACKEND_RTT=n
```

## src/main.c
```c
#include <zephyr/bluetooth/bluetooth.h>
#include <bluetooth/mesh/models.h>
#include <bluetooth/mesh/dk_prov.h>
#include <dk_buttons_and_leds.h>
#include "model_handler.h"

#include <zephyr/logging/log.h>
LOG_MODULE_REGISTER(chat, CONFIG_LOG_DEFAULT_LEVEL);

static void bt_ready(int err)
{
	if (err) {
		printk("Bluetooth init failed (err %d)\n", err);
		return;
	}

	printk("Bluetooth initialised\n");

	err = dk_leds_init();
	if (err) {
		printk("Initialising LEDs failed (err %d)\n", err);
		return;
	}

	err = dk_buttons_init(NULL);
	if (err) {
		printk("Initialising buttons failed (err %d)\n", err);
		return;
	}

	err = bt_mesh_init(bt_mesh_dk_prov_init(), model_handler_init());
	if (err) {
		printk("Initialising mesh failed (err %d)\n", err);
		return;
	}

	if (IS_ENABLED(CONFIG_SETTINGS)) {
		settings_load();
	}

	bt_mesh_prov_enable(BT_MESH_PROV_ADV | BT_MESH_PROV_GATT);

	printk("Mesh initialised\n");
}

int main(void)
{
	int err;

	printk("Initialising...\n");

	err = bt_enable(bt_ready);
	if (err) {
		printk("Bluetooth init failed (err %d)\n", err);
	}

	return 0;
}
```

## include/chat_cli.h
```c
#ifndef CHAT_CLI_H_
#define CHAT_CLI_H_

#include <zephyr/bluetooth/mesh.h>
#include "chat_cli_op.h"

#define COMPANY_ID 0xFFFF 
#define MODEL_ID   0x0001

struct bt_mesh_chat_cli;

enum bt_mesh_chat_cli_presence {
    BT_MESH_CHAT_CLI_PRESENCE_AVAILABLE,
    BT_MESH_CHAT_CLI_PRESENCE_AWAY,
    BT_MESH_CHAT_CLI_PRESENCE_DO_NOT_DISTURB,
    BT_MESH_CHAT_CLI_PRESENCE_INACTIVE,
};

struct bt_mesh_chat_cli_handlers {
    void (*start)(struct bt_mesh_chat_cli *cli);
    void (*presence)(struct bt_mesh_chat_cli *cli, struct bt_mesh_msg_ctx *ctx,
                     enum bt_mesh_chat_cli_presence presence);
    void (*message)(struct bt_mesh_chat_cli *cli, struct bt_mesh_msg_ctx *ctx,
                    const uint8_t *msg);
    void (*private_message)(struct bt_mesh_chat_cli *cli, struct bt_mesh_msg_ctx *ctx,
                            const uint8_t *msg);
    void (*message_reply)(struct bt_mesh_chat_cli *cli, struct bt_mesh_msg_ctx *ctx);
};

struct bt_mesh_chat_cli {
    struct bt_mesh_model *model;
    struct bt_mesh_model_pub pub;
    struct net_buf_simple *msg;
    struct net_buf_simple pub_msg;
    const struct bt_mesh_chat_cli_handlers *handlers;
    enum bt_mesh_chat_cli_presence presence;
    uint8_t buf[BT_MESH_TX_SDU_MAX];
};

#define BT_MESH_MODEL_CHAT_CLI(cli) \
    BT_MESH_MODEL_VND_CB(COMPANY_ID, MODEL_ID, _bt_mesh_chat_cli_op, &(cli)->pub, cli, &_bt_mesh_chat_cli_cb)

/* Function declarations */
int bt_mesh_chat_cli_message_send(struct bt_mesh_chat_cli *cli, const uint8_t *msg);
int bt_mesh_chat_cli_private_message_send(struct bt_mesh_chat_cli *cli, uint16_t addr, const uint8_t *msg);
int bt_mesh_chat_cli_presence_set(struct bt_mesh_chat_cli *cli, enum bt_mesh_chat_cli_presence presence);
int bt_mesh_chat_cli_presence_get(struct bt_mesh_chat_cli *cli, uint16_t addr);
int bt_mesh_chat_cli_send(struct bt_mesh_chat_cli *cli, const char *msg, const struct bt_mesh_msg_ctx *ctx);

/* Externs required by the macro */
extern const struct bt_mesh_model_op _bt_mesh_chat_cli_op[];
extern const struct bt_mesh_model_cb _bt_mesh_chat_cli_cb;

#endif /* CHAT_CLI_H_ */
```

## include/chat_cli_op.h
```c
#ifndef CHAT_CLI_OP_H_
#define CHAT_CLI_OP_H_

#define BT_MESH_CHAT_CLI_OP_MESSAGE           BT_MESH_MODEL_OP_3(0x00, 0xFFFF)
#define BT_MESH_CHAT_CLI_OP_PRIVATE_MESSAGE   BT_MESH_MODEL_OP_3(0x01, 0xFFFF)
#define BT_MESH_CHAT_CLI_OP_MESSAGE_REPLY     BT_MESH_MODEL_OP_3(0x02, 0xFFFF)
#define BT_MESH_CHAT_CLI_OP_PRESENCE          BT_MESH_MODEL_OP_3(0x03, 0xFFFF)
#define BT_MESH_CHAT_CLI_OP_PRESENCE_GET      BT_MESH_MODEL_OP_3(0x04, 0xFFFF)

/* Message lengths */
#define BT_MESH_CHAT_CLI_MSG_LEN_MESSAGE_REPLY    0
#define BT_MESH_CHAT_CLI_MSG_LEN_PRESENCE         1
#define BT_MESH_CHAT_CLI_MSG_LEN_PRESENCE_GET     0
#define BT_MESH_CHAT_CLI_MSG_MINLEN_MESSAGE       2
#define BT_MESH_CHAT_CLI_MSG_MAXLEN_MESSAGE       32

#endif /* CHAT_CLI_OP_H_ */
```

## src/chat_cli.c
```c
 #include <zephyr/bluetooth/mesh.h>
 #include "chat_cli.h"
 #include "mesh/net.h"
 #include <string.h>
 #include <zephyr/logging/log.h>
 #include "chat_cli_op.h"
 LOG_MODULE_DECLARE(chat);
 
 /* Ensure message fits into the available SDU buffers */
 BUILD_ASSERT(BT_MESH_MODEL_BUF_LEN(BT_MESH_CHAT_CLI_OP_MESSAGE,
					BT_MESH_CHAT_CLI_MSG_MAXLEN_MESSAGE) <=
			 BT_MESH_RX_SDU_MAX,
		  "The message must fit inside an application SDU.");
 BUILD_ASSERT(BT_MESH_MODEL_BUF_LEN(BT_MESH_CHAT_CLI_OP_MESSAGE,
					BT_MESH_CHAT_CLI_MSG_MAXLEN_MESSAGE) <=
			 BT_MESH_TX_SDU_MAX,
		  "The message must fit inside an application SDU.");
 
 /* Helper to encode presence messages */
 static void encode_presence(struct net_buf_simple *buf,
				 enum bt_mesh_chat_cli_presence presence)
 {
	 bt_mesh_model_msg_init(buf, BT_MESH_CHAT_CLI_OP_PRESENCE);
	 net_buf_simple_add_u8(buf, presence);
 }
 
 /* Helper to extract a message */
 static const uint8_t *extract_msg(struct net_buf_simple *buf)
 {
	 buf->data[buf->len - 1] = '\0';
	 return net_buf_simple_pull_mem(buf, buf->len);
 }
 
 /* Handler for incoming chat messages */
 static int handle_message(const struct bt_mesh_model *model, struct bt_mesh_msg_ctx *ctx,
			   struct net_buf_simple *buf)
 {
	 struct bt_mesh_chat_cli *chat = model->rt->user_data;
	 const uint8_t *msg;
 
	 msg = extract_msg(buf);
 
	 if (chat->handlers->message) {
		 chat->handlers->message(chat, ctx, msg);
	 }
 
	 return 0;
 }
 
 static void send_message_reply(struct bt_mesh_chat_cli *chat,
				  struct bt_mesh_msg_ctx *ctx)
 {
	 BT_MESH_MODEL_BUF_DEFINE(msg, BT_MESH_CHAT_CLI_OP_MESSAGE_REPLY,
				  BT_MESH_CHAT_CLI_MSG_LEN_MESSAGE_REPLY);
	 bt_mesh_model_msg_init(&msg, BT_MESH_CHAT_CLI_OP_MESSAGE_REPLY);
 
	 (void)bt_mesh_model_send(chat->model, ctx, &msg, NULL, NULL);
 }
 
 /* Handler for incoming private messages */
 static int handle_private_message(const struct bt_mesh_model *model, struct bt_mesh_msg_ctx *ctx,
				   struct net_buf_simple *buf)
 {
	 struct bt_mesh_chat_cli *chat = model->rt->user_data;
	 const uint8_t *msg;
 
	 msg = extract_msg(buf);
 
	 if (chat->handlers->private_message) {
		 chat->handlers->private_message(chat, ctx, msg);
	 }
 
	 send_message_reply(chat, ctx);
	 return 0;
 }
 
 /* Handler for message reply events */
 static int handle_message_reply(const struct bt_mesh_model *model, struct bt_mesh_msg_ctx *ctx,
				 struct net_buf_simple *buf)
 {
	 struct bt_mesh_chat_cli *chat = model->rt->user_data;
 
	 if (chat->handlers->message_reply) {
		 chat->handlers->message_reply(chat, ctx);
	 }
 
	 return 0;
 }
 
 /* Handler for presence messages */
 static int handle_presence(const struct bt_mesh_model *model, struct bt_mesh_msg_ctx *ctx,
				struct net_buf_simple *buf)
 {
	 struct bt_mesh_chat_cli *chat = model->rt->user_data;
	 enum bt_mesh_chat_cli_presence presence;
 
	 presence = net_buf_simple_pull_u8(buf);
 
	 if (chat->handlers->presence) {
		 chat->handlers->presence(chat, ctx, presence);
	 }
 
	 return 0;
 }
 
 /* Handler for presence get messages */
 static int handle_presence_get(const struct bt_mesh_model *model, struct bt_mesh_msg_ctx *ctx,
					struct net_buf_simple *buf)
 {
	 struct bt_mesh_chat_cli *chat = model->rt->user_data;
 
	 BT_MESH_MODEL_BUF_DEFINE(msg, BT_MESH_CHAT_CLI_OP_PRESENCE,
				  BT_MESH_CHAT_CLI_MSG_LEN_PRESENCE);
 
	 encode_presence(&msg, chat->presence);
 
	 (void)bt_mesh_model_send(chat->model, ctx, &msg, NULL, NULL);
 
	 return 0;
 }
 
 /* Chat model operations */
 const struct bt_mesh_model_op _bt_mesh_chat_cli_op[] = {
	 {
		 BT_MESH_CHAT_CLI_OP_MESSAGE,
		 BT_MESH_LEN_MIN(BT_MESH_CHAT_CLI_MSG_MINLEN_MESSAGE),
		 handle_message
	 },
	 {
		 BT_MESH_CHAT_CLI_OP_PRIVATE_MESSAGE,
		 BT_MESH_LEN_MIN(BT_MESH_CHAT_CLI_MSG_MINLEN_MESSAGE),
		 handle_private_message
	 },
	 {
		 BT_MESH_CHAT_CLI_OP_MESSAGE_REPLY,
		 BT_MESH_LEN_EXACT(BT_MESH_CHAT_CLI_MSG_LEN_MESSAGE_REPLY),
		 handle_message_reply
	 },
	 {
		 BT_MESH_CHAT_CLI_OP_PRESENCE,
		 BT_MESH_LEN_EXACT(BT_MESH_CHAT_CLI_MSG_LEN_PRESENCE),
		 handle_presence
	 },
	 {
		 BT_MESH_CHAT_CLI_OP_PRESENCE_GET,
		 BT_MESH_LEN_EXACT(BT_MESH_CHAT_CLI_MSG_LEN_PRESENCE_GET),
		 handle_presence_get
	 },
	 BT_MESH_MODEL_OP_END,
 };
 
 /* Update handler for periodic pulication */
 static int bt_mesh_chat_cli_update_handler(const struct bt_mesh_model *model)
 {
	 struct bt_mesh_chat_cli *chat = model->rt->user_data;
	 encode_presence(model->pub->msg, chat->presence);
	 return 0;
 }
 
 #ifdef CONFIG_BT_SETTINGS
 static int bt_mesh_chat_cli_settings_set(const struct bt_mesh_model *model,
					  const char *name,
					  size_t len_rd,
					  settings_read_cb read_cb,
					  void *cb_arg)
 {
	 struct bt_mesh_chat_cli *chat = model->rt->user_data;
 
	 if (name) {
		 return -ENOENT;
	 }
 
	 ssize_t bytes = read_cb(cb_arg, &chat->presence, sizeof(chat->presence));
	 if (bytes < 0) {
		 return bytes;
	 }
 
	 if (bytes != 0 && bytes != sizeof(chat->presence)) {
		 return -EINVAL;
	 }
 
	 return 0;
 }
 #endif
 
 /* Initialise the chat client model */
 static int bt_mesh_chat_cli_init(const struct bt_mesh_model *model)
 {
	 struct bt_mesh_chat_cli *chat = model->rt->user_data;
 
	 chat->model = model;
	 net_buf_simple_init_with_data(&chat->pub_msg, chat->buf, sizeof(chat->buf));
	 chat->pub.msg = &chat->pub_msg;
	 chat->pub.update = bt_mesh_chat_cli_update_handler;
 
	 return 0;
 }
 
 /* Start the chat client model */
 static int bt_mesh_chat_cli_start(const struct bt_mesh_model *model)
 {
	 struct bt_mesh_chat_cli *chat = model->rt->user_data;
 
	 if (chat->handlers->start) {
		 chat->handlers->start(chat);
	 }
 
	 return 0;
 }
 
 /* Reset the chat client model */
 static void bt_mesh_chat_cli_reset(const struct bt_mesh_model *model)
 {
	 struct bt_mesh_chat_cli *chat = model->rt->user_data;
	 chat->presence = BT_MESH_CHAT_CLI_PRESENCE_AVAILABLE;
 
	 if (IS_ENABLED(CONFIG_BT_SETTINGS)) {
		 (void) bt_mesh_model_data_store(model, true, NULL, NULL, 0);
	 }
 }
 
 const struct bt_mesh_model_cb _bt_mesh_chat_cli_cb = {
	 .init = bt_mesh_chat_cli_init,
	 .start = bt_mesh_chat_cli_start,
 #ifdef CONFIG_BT_SETTINGS
	 .settings_set = bt_mesh_chat_cli_settings_set,
 #endif
	 .reset = bt_mesh_chat_cli_reset,
 };
 
 /* Set presence */
 int bt_mesh_chat_cli_presence_set(struct bt_mesh_chat_cli *chat,
				   enum bt_mesh_chat_cli_presence presence)
 {
	 if (presence != chat->presence) {
		 chat->presence = presence;
 
		 if (IS_ENABLED(CONFIG_BT_SETTINGS)) {
			 (void) bt_mesh_model_data_store(chat->model, true, NULL,
							 &presence, sizeof(chat->presence));
		 }
	 }
 
	 encode_presence(chat->model->pub->msg, chat->presence);
	 return bt_mesh_model_publish(chat->model);
 }
 
 /* Get presence */
 int bt_mesh_chat_cli_presence_get(struct bt_mesh_chat_cli *chat,
				   uint16_t addr)
 {
	 struct bt_mesh_msg_ctx ctx = {
		 .addr = addr,
		 .app_idx = chat->model->keys[0],
		 .send_ttl = BT_MESH_TTL_DEFAULT,
		 .send_rel = true,
	 };
 
	 BT_MESH_MODEL_BUF_DEFINE(buf, BT_MESH_CHAT_CLI_OP_PRESENCE_GET,
				  BT_MESH_CHAT_CLI_MSG_LEN_PRESENCE_GET);
	 bt_mesh_model_msg_init(&buf, BT_MESH_CHAT_CLI_OP_PRESENCE_GET);
	 return bt_mesh_model_send(chat->model, &ctx, &buf, NULL, NULL);
 }

 int bt_mesh_chat_cli_message_send(struct bt_mesh_chat_cli *chat,
				   const uint8_t *msg)
 {
	 struct net_buf_simple *buf = chat->model->pub->msg;
	 bt_mesh_model_msg_init(buf, BT_MESH_CHAT_CLI_OP_MESSAGE);
	 net_buf_simple_add_mem(buf, msg, strnlen(msg, CONFIG_BT_MESH_CHAT_CLI_MESSAGE_LENGTH));
	 net_buf_simple_add_u8(buf, '\0');
	 return bt_mesh_model_publish(chat->model);
 }
 
 int bt_mesh_chat_cli_private_message_send(struct bt_mesh_chat_cli *chat,
						 uint16_t addr,
						 const uint8_t *msg)
 {
	 struct bt_mesh_msg_ctx ctx = {
		 .addr = addr,
		 .app_idx = chat->model->keys[0],
		 .send_ttl = BT_MESH_TTL_DEFAULT,
		 .send_rel = true,
	 };
 
	 BT_MESH_MODEL_BUF_DEFINE(buf, BT_MESH_CHAT_CLI_OP_PRIVATE_MESSAGE,
				  BT_MESH_CHAT_CLI_MSG_MAXLEN_MESSAGE);
	 bt_mesh_model_msg_init(&buf, BT_MESH_CHAT_CLI_OP_PRIVATE_MESSAGE);
	 net_buf_simple_add_mem(&buf, msg, strnlen(msg, CONFIG_BT_MESH_CHAT_CLI_MESSAGE_LENGTH));
	 net_buf_simple_add_u8(&buf, '\0');
	 return bt_mesh_model_send(chat->model, &ctx, &buf, NULL, NULL);
 }
 
 /* Alows the application to re-send or forward a message using a custom context*/
 int bt_mesh_chat_cli_send(struct bt_mesh_chat_cli *cli, const char *msg,
			   const struct bt_mesh_msg_ctx *ctx)
 {
	 struct net_buf_simple *buf = cli->model->pub->msg;
	 bt_mesh_model_msg_init(buf, BT_MESH_CHAT_CLI_OP_MESSAGE);
	 net_buf_simple_add_mem(buf, msg, strnlen(msg, CONFIG_BT_MESH_CHAT_CLI_MESSAGE_LENGTH));
	 net_buf_simple_add_u8(buf, '\0');
	 return bt_mesh_model_send(cli->model, ctx, buf, NULL, NULL);
 }
 
```

## src/model_handler.c
```c
 #include <stdio.h>
 #include <zephyr/bluetooth/bluetooth.h>
 #include <bluetooth/mesh/models.h>
 #include <dk_buttons_and_leds.h>
 #include <zephyr/shell/shell.h>
 #include <zephyr/shell/shell_uart.h>
 #include "chat_cli.h" 
 #include "chat_cli_op.h"
 #include "model_handler.h"
 #include <zephyr/logging/log.h>
 LOG_MODULE_DECLARE(chat);
 
#define COMPANY_ID 0xFE58  
#define MODEL_ID   0x1234  

 static struct k_work_delayable attention_blink_work;
 static bool attention;
 static const struct shell *chat_shell;

 static void attention_blink(struct k_work *work)
 {
	 static int idx;
	 const uint8_t pattern[] = {
		 BIT(0) | BIT(1),
		 BIT(1) | BIT(2),
		 BIT(2) | BIT(3),
		 BIT(3) | BIT(0),
	 };
 
	 if (attention) {
		 dk_set_leds(pattern[idx++ % ARRAY_SIZE(pattern)]);
		 k_work_reschedule(&attention_blink_work, K_MSEC(30));
	 } else {
		 dk_set_leds(DK_NO_LEDS_MSK);
	 }
 }
 
 static void attention_on(const struct bt_mesh_model *mod)
 {
	 attention = true;
	 k_work_reschedule(&attention_blink_work, K_NO_WAIT);
 }
 
 static void attention_off(const struct bt_mesh_model *mod)
 {
	 attention = false;
 }
 
 static const struct bt_mesh_health_srv_cb health_srv_cb = {
	 .attn_on = attention_on,
	 .attn_off = attention_off,
 };
 
 static struct bt_mesh_health_srv health_srv = {
	 .cb = &health_srv_cb,
 };
 
 BT_MESH_HEALTH_PUB_DEFINE(health_pub, 0);
 
 /* Chat model setup */ 
 struct presence_cache {
	 uint16_t addr;
	 enum bt_mesh_chat_cli_presence presence;
 };
 
 static struct presence_cache presence_cache[CONFIG_BT_MESH_CHAT_SAMPLE_PRESENCE_CACHE_SIZE];
 
 static const uint8_t *presence_string[] = {
	 [BT_MESH_CHAT_CLI_PRESENCE_AVAILABLE]     = "available",
	 [BT_MESH_CHAT_CLI_PRESENCE_AWAY]            = "away",
	 [BT_MESH_CHAT_CLI_PRESENCE_DO_NOT_DISTURB]  = "dnd",
	 [BT_MESH_CHAT_CLI_PRESENCE_INACTIVE]        = "inactive",
 };
 
 /* Returns true if the specified address is an address of the local element. */
 static bool address_is_local(const struct bt_mesh_model *mod, uint16_t addr)
 {
	 return bt_mesh_model_elem(mod)->rt->addr == addr;
 }
 
 /* Returns true if the provided address is a unicast address. */
 static bool address_is_unicast(uint16_t addr)
 {
	 return (addr > 0) && (addr <= 0x7FFF);
 }
 
 /* Returns true if the node is new or the presence status is different from
  * the one stored in the cache */
 static bool presence_cache_entry_check_and_update(uint16_t addr,
						enum bt_mesh_chat_cli_presence presence)
 {
	 static size_t presence_cache_head;
	 size_t i;
 
	 for (i = 0; i < ARRAY_SIZE(presence_cache); i++) {
		 if (presence_cache[i].addr == addr) {
			 if (presence_cache[i].presence == presence) {
				 return false;
			 }
			 break;
		 }
	 }
 
	 if (i == ARRAY_SIZE(presence_cache)) {
		 for (i = 0; i < ARRAY_SIZE(presence_cache); i++) {
			 if (!presence_cache[i].addr) {
				 break;
			 }
		 }
		 if (i == ARRAY_SIZE(presence_cache)) {
			 i = presence_cache_head;
			 presence_cache_head = (presence_cache_head + 1) % CONFIG_BT_MESH_CHAT_SAMPLE_PRESENCE_CACHE_SIZE;
		 }
	 }
 
	 presence_cache[i].addr = addr;
	 presence_cache[i].presence = presence;
 
	 return true;
 }
 
 static void print_client_status(void);
 
 static void handle_chat_start(struct bt_mesh_chat_cli *chat)
 {
	 print_client_status();
 }
 
 static void handle_chat_presence(struct bt_mesh_chat_cli *chat,
				  struct bt_mesh_msg_ctx *ctx,
				  enum bt_mesh_chat_cli_presence presence)
 {
	 if (address_is_local(chat->model, ctx->addr)) {
		 if (address_is_unicast(ctx->recv_dst)) {
			 shell_print(chat_shell, "<you> are %s", presence_string[presence]);
		 }
	 } else {
		 if (address_is_unicast(ctx->recv_dst)) {
			 shell_print(chat_shell, "<0x%04X> is %s", ctx->addr, presence_string[presence]);
		 } else if (presence_cache_entry_check_and_update(ctx->addr, presence)) {
			 shell_print(chat_shell, "<0x%04X> is now %s", ctx->addr, presence_string[presence]);
		 }
	 }
 }
 
 static void handle_chat_message(struct bt_mesh_chat_cli *chat,
				 struct bt_mesh_msg_ctx *ctx,
				 const uint8_t *msg)
 {
	 /* Don't print own messages. */
	 if (address_is_local(chat->model, ctx->addr)) {
		 return;
	 }
 
	 shell_print(chat_shell, "<0x%04X>: %s", ctx->addr, msg);
 
	 /* Forwarding Logic */
	 if (!address_is_unicast(ctx->recv_dst)) {
		 struct bt_mesh_msg_ctx forward_ctx = {
			 .net_idx = ctx->net_idx,
			 .app_idx = ctx->app_idx,
			 .addr = ctx->recv_dst,
			 .send_ttl = BT_MESH_TTL_DEFAULT,
		 };
 
		 /* Forward the message using the new API */
		 bt_mesh_chat_cli_send(chat, (const char *)msg, &forward_ctx);
	 }
 }
 
 static void handle_chat_private_message(struct bt_mesh_chat_cli *chat,
					 struct bt_mesh_msg_ctx *ctx,
					 const uint8_t *msg)
 {
	 if (address_is_local(chat->model, ctx->addr)) {
		 return;
	 }
	 shell_print(chat_shell, "<0x%04X>: *you* %s", ctx->addr, msg);
 }
 
 static void handle_chat_message_reply(struct bt_mesh_chat_cli *chat,
					   struct bt_mesh_msg_ctx *ctx)
 {
	 shell_print(chat_shell, "<0x%04X> received the message", ctx->addr);
 }
 
 static const struct bt_mesh_chat_cli_handlers chat_handlers = {
	 .start = handle_chat_start,
	 .presence = handle_chat_presence,
	 .message = handle_chat_message,
	 .private_message = handle_chat_private_message,
	 .message_reply = handle_chat_message_reply,
 };
 
 static struct bt_mesh_chat_cli chat = {
    .handlers = &chat_handlers,
};

static struct bt_mesh_elem elements[] = {
    BT_MESH_ELEM(1,
        BT_MESH_MODEL_LIST(
            BT_MESH_MODEL_CFG_SRV,
            BT_MESH_MODEL_HEALTH_SRV(&health_srv, &health_pub)
        ),
        BT_MESH_MODEL_LIST(
            BT_MESH_MODEL_CHAT_CLI(&chat)
        )
    )
};

 
 static void print_client_status(void)
 {
	 if (!bt_mesh_is_provisioned()) {
		 shell_print(chat_shell, "The mesh node is not provisioned. Please provision the mesh node before using the chat.");
	 } else {
		 shell_print(chat_shell, "The mesh node is provisioned. The client address is 0x%04x.", bt_mesh_model_elem(chat.model)->rt->addr);
	 }
	 shell_print(chat_shell, "Current presence: %s", presence_string[chat.presence]);
 }
 
 static const struct bt_mesh_comp comp = {
	 .cid = CONFIG_BT_COMPANY_ID,
	 .elem = elements,
	 .elem_count = ARRAY_SIZE(elements),
 };
 
 /* Chat shell commands */
 static int cmd_status(const struct shell *shell, size_t argc, char *argv[])
 {
	 print_client_status();
	 return 0;
 }
 
 static int cmd_message(const struct shell *shell, size_t argc, char *argv[])
 {
	 int err;
	 if (argc < 2) {
		 return -EINVAL;
	 }
	 err = bt_mesh_chat_cli_message_send(&chat, argv[1]);
	 if (err) {
		 LOG_WRN("Failed to send message: %d", err);
	 }
	 shell_print(shell, "<you>: %s", argv[1]);
	 return 0;
 }
 
 static int cmd_private_message(const struct shell *shell, size_t argc, char *argv[])
 {
	 uint16_t addr;
	 int err;
	 if (argc < 3) {
		 return -EINVAL;
	 }
	 addr = strtol(argv[1], NULL, 0);
	 shell_print(shell, "<you>: *0x%04X* %s", addr, argv[2]);
	 err = bt_mesh_chat_cli_private_message_send(&chat, addr, argv[2]);
	 if (err) {
		 LOG_WRN("Failed to publish message: %d", err);
	 }
	 return 0;
 }
 
 static int cmd_presence_set(const struct shell *shell, size_t argc, char *argv[])
 {
	 size_t i;
	 if (argc < 2) {
		 return -EINVAL;
	 }
	 for (i = 0; i < ARRAY_SIZE(presence_string); i++) {
		 if (!strcmp(argv[1], presence_string[i])) {
			 enum bt_mesh_chat_cli_presence presence;
			 int err;
			 presence = i;
			 err = bt_mesh_chat_cli_presence_set(&chat, presence);
			 if (err) {
				 LOG_WRN("Failed to update presence: %d", err);
			 }
			 shell_print(shell, "You are now %s", presence_string[presence]);
			 return 0;
		 }
	 }
	 shell_print(shell, "Unknown presence status: %s. Possible presence statuses:", argv[1]);
	 for (i = 0; i < ARRAY_SIZE(presence_string); i++) {
		 shell_print(shell, "%s", presence_string[i]);
	 }
	 return 0;
 }
 
 static int cmd_presence_get(const struct shell *shell, size_t argc, char *argv[])
 {
	 uint16_t addr;
	 int err;
	 if (argc < 2) {
		 return -EINVAL;
	 }
	 addr = strtol(argv[1], NULL, 0);
	 err = bt_mesh_chat_cli_presence_get(&chat, addr);
	 if (err) {
		 LOG_WRN("Failed to publish message: %d", err);
	 }
	 return 0;
 }
 
 SHELL_STATIC_SUBCMD_SET_CREATE(presence_cmds,
	 SHELL_CMD_ARG(set, NULL,
			   "Set presence of the current client <presence: available, away, dnd or inactive>",
			   cmd_presence_set, 2, 0),
	 SHELL_CMD_ARG(get, NULL,
			   "Get presence status of the remote node <node>",
			   cmd_presence_get, 2, 0),
	 SHELL_SUBCMD_SET_END
 );
 
 static int cmd_presence(const struct shell *shell, size_t argc, char *argv[])
 {
	 if (argc == 1) {
		 shell_help(shell);
		 return 1;
	 }
	 if (argc != 3) {
		 return -EINVAL;
	 }
	 return 0;
 }
 
 SHELL_STATIC_SUBCMD_SET_CREATE(chat_cmds,
	 SHELL_CMD_ARG(status, NULL, "Print client status", cmd_status, 1, 0),
	 SHELL_CMD(presence, &presence_cmds, "Presence commands", cmd_presence),
	 SHELL_CMD_ARG(private, NULL,
			   "Send a private text message to a client <node> <message>",
			   cmd_private_message, 3, 0),
	 SHELL_CMD_ARG(msg, NULL, "Send a text message to the chat <message>",
			   cmd_message, 2, 0),
	 SHELL_SUBCMD_SET_END
 );
 
 static int cmd_chat(const struct shell *shell, size_t argc, char **argv)
 {
	 if (argc == 1) {
		 shell_help(shell);
		 return 1;
	 }
	 shell_error(shell, "%s unknown parameter: %s", argv[0], argv[1]);
	 return -EINVAL;
 }
 
 SHELL_CMD_ARG_REGISTER(chat, &chat_cmds, "Bluetooth Mesh Chat Client commands",
				cmd_chat, 1, 1);
 
 /* Public API */
 const struct bt_mesh_comp *model_handler_init(void)
 {
	 k_work_init_delayable(&attention_blink_work, attention_blink);
	 chat_shell = shell_backend_uart_get_ptr();
	 return &comp;
 }
 
```
